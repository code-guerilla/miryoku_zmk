// Copyright 2024 Manna Harbour
// https://github.com/manna-harbour/miryoku

#include "../miryoku/custom_config.h"
#include "../miryoku/mapping/46/anywhy_flake.h"
#include "../miryoku/miryoku.dtsi"
#include "anywhy_flake.dtsi"
